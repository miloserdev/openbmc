## meta-mcst/conf/layer.conf
```bitbake
# We have a conf and classes directory, add to BBPATH
BBPATH .= ":${LAYERDIR}"

BBFILE_COLLECTIONS += "mcst"
BBFILE_PATTERN_mcst = ""
```

## meta-mcst/meta-common/conf/layer.conf
```bitbake
BBPATH .= ":${LAYERDIR}"
BBFILES += "${LAYERDIR}/recipes-*/*/*.bb \
            ${LAYERDIR}/recipes-*/*/*.bbappend"

SANITY_TESTED_DISTROS_append ?= " \
                                  ubuntu-18.04 \n \
                                  ubuntu-18.10 \n \
                                  ubuntu-20.04 \n \
                                "
```

## meta-mcst/meta-device-reimu-4232/conf/bblayers.conf.sample
```bitbake
# LAYER_CONF_VERSION is increased each time build/conf/bblayers.conf
# changes incompatibly
LCONF_VERSION = "8"

BBPATH = "${TOPDIR}"
BBFILES ?= ""

BBLAYERS ?= " \
  ##OEROOT##/meta \
  ##OEROOT##/meta-openembedded/meta-oe \
  ##OEROOT##/meta-openembedded/meta-networking \
  ##OEROOT##/meta-openembedded/meta-perl \
  ##OEROOT##/meta-openembedded/meta-python \
  ##OEROOT##/meta-openembedded/meta-webserver \
  ##OEROOT##/meta-phosphor \
  ##OEROOT##/meta-aspeed \
  ##OEROOT##/meta-mcst/meta-common \
  ##OEROOT##/meta-mcst/meta-flash32 \
  ##OEROOT##/meta-mcst/meta-embedded \
  ##OEROOT##/meta-mcst/meta-embedded-2400 \
  ##OEROOT##/meta-mcst/meta-uart2 \
  ##OEROOT##/meta-mcst/meta-device-reimu-4232 \
  "
BBLAYERS_NON_REMOVABLE ?= " \
  ##OEROOT##/meta \
  ##OEROOT##/meta-openembedded/meta-oe \
  ##OEROOT##/meta-openembedded/meta-networking \
  ##OEROOT##/meta-openembedded/meta-perl \
  ##OEROOT##/meta-openembedded/meta-python \
  ##OEROOT##/meta-openembedded/meta-webserver \
  ##OEROOT##/meta-phosphor \
  ##OEROOT##/meta-aspeed \
  ##OEROOT##/meta-mcst/meta-common \
  ##OEROOT##/meta-mcst/meta-flash32 \
  ##OEROOT##/meta-mcst/meta-embedded \
  ##OEROOT##/meta-mcst/meta-embedded-2400 \
  ##OEROOT##/meta-mcst/meta-uart2 \
  ##OEROOT##/meta-mcst/meta-device-reimu-4232 \
  "
```

## meta-mcst/meta-device-reimu-4232/conf/layer.conf
```bitbake
# We have a conf and classes directory, add to BBPATH
BBPATH .= ":${LAYERDIR}"

# We have recipes-* directories, add to BBFILES
BBFILES += "${LAYERDIR}/recipes-*/*/*.bb \
            ${LAYERDIR}/recipes-*/*/*.bbappend"

BBFILE_COLLECTIONS += "reimu-4232-layer"
BBFILE_PATTERN_reimu-4232-layer = "^${LAYERDIR}/"
LAYERSERIES_COMPAT_reimu-4232-layer = "warrior zeus dunfell gatesgarth"
```

## meta-mcst/meta-device-reimu-4232/conf/machine/reimu-4232.conf
```bitbake
require conf/machine/include/reimu.inc
require conf/machine/include/ast2400.inc
UBOOT_MACHINE_reimu-4232 = "ast_g4_phy_config"
MACHINE_STRING = "REIMU-4232 AST2400"
```

## meta-mcst/meta-device-reimu-4232m/conf/layer.conf
```bitbake
# We have a conf and classes directory, add to BBPATH
BBPATH .= ":${LAYERDIR}"

# We have recipes-* directories, add to BBFILES
BBFILES += "${LAYERDIR}/recipes-*/*/*.bb \
            ${LAYERDIR}/recipes-*/*/*.bbappend"

BBFILE_COLLECTIONS += "reimu-4232m-layer"
BBFILE_PATTERN_reimu-4232m-layer = "^${LAYERDIR}/"
LAYERSERIES_COMPAT_reimu-4232m-layer = "warrior zeus dunfell gatesgarth"
```

## meta-mcst/meta-device-reimu-4264/conf/machine/reimu-4264.conf
```bitbake
require conf/machine/include/reimu.inc
require conf/machine/include/ast2400.inc
UBOOT_MACHINE_reimu-4264 = "ast_g4_phy_config"
MACHINE_STRING = "REIMU-4264 AST2400"
```

## meta-mcst/meta-device-reimu-4564/conf/machine/reimu-4564.conf
```bitbake
require conf/machine/include/reimu.inc
require conf/machine/include/ast2400.inc
UBOOT_MACHINE_reimu-4564 = "ast_g4_phy_config"
MACHINE_STRING = "REIMU-4564 AST2400"
```

## meta-mcst/meta-device-reimu-5564/conf/bblayers.conf.sample
```bitbake
# LAYER_CONF_VERSION is increased each time build/conf/bblayers.conf
# changes incompatibly
LCONF_VERSION = "8"

BBPATH = "${TOPDIR}"
BBFILES ?= ""

BBLAYERS ?= " \
  ##OEROOT##/meta \
  ##OEROOT##/meta-openembedded/meta-oe \
  ##OEROOT##/meta-openembedded/meta-networking \
  ##OEROOT##/meta-openembedded/meta-perl \
  ##OEROOT##/meta-openembedded/meta-python \
  ##OEROOT##/meta-openembedded/meta-webserver \
  ##OEROOT##/meta-phosphor \
  ##OEROOT##/meta-aspeed \
  ##OEROOT##/meta-mcst/meta-common \
  ##OEROOT##/meta-mcst/meta-flash64 \
  ##OEROOT##/meta-mcst/meta-embedded \
  ##OEROOT##/meta-mcst/meta-embedded-2500 \
  ##OEROOT##/meta-mcst/meta-rtc \
  ##OEROOT##/meta-mcst/meta-uart5 \
  ##OEROOT##/meta-mcst/meta-reliable-upgrade \
  ##OEROOT##/meta-mcst/meta-device-reimu-5564 \
  "
BBLAYERS_NON_REMOVABLE ?= " \
  ##OEROOT##/meta \
  ##OEROOT##/meta-openembedded/meta-oe \
  ##OEROOT##/meta-openembedded/meta-networking \
  ##OEROOT##/meta-openembedded/meta-perl \
  ##OEROOT##/meta-openembedded/meta-python \
  ##OEROOT##/meta-openembedded/meta-webserver \
  ##OEROOT##/meta-phosphor \
  ##OEROOT##/meta-aspeed \
  ##OEROOT##/meta-mcst/meta-common \
  ##OEROOT##/meta-mcst/meta-flash64 \
  ##OEROOT##/meta-mcst/meta-embedded \
  ##OEROOT##/meta-mcst/meta-embedded-2500 \
  ##OEROOT##/meta-mcst/meta-rtc \
  ##OEROOT##/meta-mcst/meta-uart5 \
  ##OEROOT##/meta-mcst/meta-reliable-upgrade \
  ##OEROOT##/meta-mcst/meta-device-reimu-5564 \
  "
```

## meta-mcst/meta-device-reimu-5564/conf/layer.conf
```bitbake
# We have a conf and classes directory, add to BBPATH
BBPATH .= ":${LAYERDIR}"

# We have recipes-* directories, add to BBFILES
BBFILES += "${LAYERDIR}/recipes-*/*/*.bb \
            ${LAYERDIR}/recipes-*/*/*.bbappend"

BBFILE_COLLECTIONS += "reimu-5564-layer"
BBFILE_PATTERN_reimu-5564-layer = "^${LAYERDIR}/"
LAYERSERIES_COMPAT_reimu-5564-layer = "warrior zeus dunfell gatesgarth"

hostname_pn-base-files = "miloserd-5564"
```

## meta-mcst/meta-device-reimu-5564/conf/machine/reimu-5564.conf
```bitbake
require conf/machine/include/reimu.inc
require conf/machine/include/ast2500.inc
UBOOT_MACHINE_reimu-5564 = "ast_g5_phy_config"
MACHINE_STRING = "MILOSERD-5564 AST2500"
```

## meta-mcst/meta-flash32/conf/machine/include/flash.inc
```bitbake
FLASH_SIZE = "32768"
FLASH_UBOOT_OFFSET = "0"
FLASH_KERNEL_OFFSET = "512"
FLASH_ROFS_OFFSET = "4928"
FLASH_RWFS_OFFSET = "28672"
```

## meta-mcst/meta-flash64/conf/machine/include/flash.inc
```bitbake
FLASH_SIZE = "65536"
FLASH_UBOOT_OFFSET = "0"
FLASH_UBOOT_ENV_OFFSET = "384"
FLASH_KERNEL_OFFSET = "512"
FLASH_UBI_OFFSET = "${FLASH_KERNEL_OFFSET}"
FLASH_ROFS_OFFSET = "5632"
FLASH_RWFS_OFFSET = "49152"
```

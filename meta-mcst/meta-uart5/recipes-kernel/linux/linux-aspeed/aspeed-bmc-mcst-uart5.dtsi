// SPDX-License-Identifier: GPL-2.0+

/ {
	aliases {
		serial4 = &uart5; /* AST - Service connector */
		serial0 = &uart1; /* AST - IOHUB ttyS1 */
	};
	chosen {
		stdout-path = "serial4:115200n8";
		bootargs = "console=ttyS4,115200 earlyprintk";
	};
};
